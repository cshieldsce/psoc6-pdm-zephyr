## CMakeLists.txt
```
cmake_minimum_required(VERSION 3.20.0)
find_package(Zephyr REQUIRED HINTS $ENV{ZEPHYR_BASE})
project(psoc6_pdm_example)

set(PDL_INC $ENV{ZEPHYR_BASE}/../modules/hal/infineon/mtb-pdl-cat1/devices/COMPONENT_CAT1A/include)
set(PDL_SRC $ENV{ZEPHYR_BASE}/../modules/hal/infineon/mtb-pdl-cat1/drivers/source)
set(PDL_DRV_INC $ENV{ZEPHYR_BASE}/../modules/hal/infineon/mtb-pdl-cat1/drivers/include)

target_sources(app PRIVATE
    src/main.c
    src/acoustic/acoustic.c
    src/acoustic/psoc6_pdm.c
    ${PDL_SRC}/cy_pdm_pcm.c
)

target_include_directories(app PRIVATE
    src
    src/acoustic
    ${PDL_INC}
    ${PDL_INC}/ip
    ${PDL_DRV_INC}
)
```

## prj.conf
```kconfig
# psoc6-pdm-zephyr
# prj.conf : Zephyr Kconfig for the PDM example application

# Core
CONFIG_MULTITHREADING=y
CONFIG_STD_C23=y

# Logging - use immediate mode so log messages from early init
# (before the logging thread is scheduled) are not dropped.
CONFIG_LOG=y
CONFIG_LOG_MODE_IMMEDIATE=y
CONFIG_LOG_BACKEND_UART=y
CONFIG_LOG_DEFAULT_LEVEL=3     # 3 = INF; set to 4 for DBG verbosity
CONFIG_PRINTK=y

# Console / UART (KitProg3 CDC on SCB5)
CONFIG_CONSOLE=y
CONFIG_UART_CONSOLE=y
CONFIG_SERIAL=y

# GPIO (LED heartbeat on P5.3, user button on P5.2)
CONFIG_GPIO=y

# Watchdog (board defconfig enables it; keep it on)
CONFIG_WATCHDOG=y

# Networking not needed for this standalone audio example
CONFIG_NETWORKING=n

# Heap size for dynamic allocation (audio buffers, logging infrastructure).
# 8 KB is sufficient for 1600-sample int16 frames + log backend.
CONFIG_HEAP_MEM_POOL_SIZE=8192

# Main thread stack. Default (1 KB) is too small when the audio loop
# calls LOG_INF with formatted strings on every frame. 4 KB is safe.
CONFIG_MAIN_STACK_SIZE=4096

# MPU disabled for now to simplify bare-metal PDL register access.
# Re-enable once the driver is fully validated and all peripheral
# regions are properly attributed.
CONFIG_ARM_MPU=n
```

## boards/cy8ckit_062s2_ai.overlay
```dts
/*
 * psoc6-pdm-zephyr - Board overlay
 * Copyright (c) 2026 Charlie Shields
 * SPDX-License-Identifier: Apache-2.0
 *
 * Enable HFCLK1 at 100 MHz (source: FLL) for AUDIOSS PDM peripheral.
 */

/* Enable HF1: source=fll0 (100MHz), div=/1 = 100MHz */
&clk_hf1 {
	status = "okay";
	clock-div = <1>;
	clocks = <&fll0>;
};
```

## src/main.c
```c
/*
 * Copyright (c) 2026 Charlie Shields
 * SPDX-License-Identifier: Apache-2.0
 *
 * psoc6-pdm-zephyr
 * main.c : Boot, LED heartbeat, acoustic energy gate
 *
 * Demonstrates PDM microphone capture on the CY8CKIT-062S2-AI board.
 * Logs per-frame energy and triggers when sound exceeds threshold.
 */

#include <zephyr/kernel.h>
#include <zephyr/logging/log.h>
#include <zephyr/version.h>
#include <zephyr/drivers/gpio.h>

#include "acoustic/acoustic.h"

LOG_MODULE_REGISTER(pdm_example, LOG_LEVEL_DBG);

#define LED0_NODE DT_ALIAS(led0)
static const struct gpio_dt_spec led = GPIO_DT_SPEC_GET(LED0_NODE, gpios);

/* Audio frame buffer - 1600 samples @ 16 kHz = 100 ms */
static int16_t audio_buf[ACOUSTIC_FRAME_SAMPLES];

int main(void)
{
    LOG_INF("========================================");
    LOG_INF("  psoc6-pdm-zephyr");
    LOG_INF("  Zephyr %s", KERNEL_VERSION_STRING);
    LOG_INF("  Board : CY8CKIT-062S2-AI");
    LOG_INF("  Mic   : 2x IM72D128V01XTMA1 (PDM)");
    LOG_INF("========================================");

    /* LED init */
    if (!gpio_is_ready_dt(&led)) {
        LOG_ERR("LED GPIO not ready");
        return -1;
    }
    gpio_pin_configure_dt(&led, GPIO_OUTPUT_ACTIVE);

    /* Acoustic init */
    if (acoustic_init() != 0) {
        LOG_ERR("Acoustic init failed - check PDM clock/pinmux + board target");
        while (1) {
            gpio_pin_toggle_dt(&led);
            k_msleep(100);  /* fast blink = error */
        }
    }

    LOG_INF("Entering audio capture loop...");

    uint32_t frame = 0;

    while (1) {
        if (acoustic_capture(audio_buf) == 0) {
            uint32_t energy = acoustic_energy(audio_buf,
                                              ACOUSTIC_FRAME_SAMPLES);

            LOG_INF("Frame %5u | Energy: %8u | %s",
                    frame,
                    energy,
                    energy > ACOUSTIC_ENERGY_THRESHOLD ? "*** TRIGGERED ***"
                                                       : "quiet");

            gpio_pin_toggle_dt(&led);
        }
        frame++;
    }

    return 0;
}
```
